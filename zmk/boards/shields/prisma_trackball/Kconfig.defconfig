## zmk/boards/shields/prisma_trackball/Kconfig.defconfig
```kconfig
# SPDX-License-Identifier: MIT

if SHIELD_PRISMA_TRACKBALL

config ZMK_KEYBOARD_NAME
    default "SD Trackball"

endif
```

## zmk/boards/shields/prisma_trackball/Kconfig.shield
```kconfig
# SPDX-License-Identifier: MIT

config SHIELD_PRISMA_TRACKBALL
    def_bool $(shields_list_contains,prisma_trackball)
```

## zmk/boards/shields/prisma_trackball_xiao/Kconfig.defconfig
```kconfig
# SPDX-License-Identifier: MIT

if SHIELD_PRISMA_TRACKBALL_XIAO

config ZMK_KEYBOARD_NAME
    default "SD Trackball"

endif
```

## zmk/boards/shields/prisma_trackball_xiao/Kconfig.shield
```kconfig
# SPDX-License-Identifier: MIT

config SHIELD_PRISMA_TRACKBALL_XIAO
    def_bool $(shields_list_contains,prisma_trackball_xiao)
```

## zmk/boards/shields/prisma_trackpad/Kconfig.defconfig
```kconfig
# SPDX-License-Identifier: MIT

if SHIELD_PRISMA_TRACKPAD

config ZMK_KEYBOARD_NAME
    default "SD Trackpad"

endif
```

## zmk/boards/shields/prisma_trackpad/Kconfig.shield
```kconfig
# SPDX-License-Identifier: MIT

config SHIELD_PRISMA_TRACKPAD
    def_bool $(shields_list_contains,prisma_trackpad)
```

## zmk/boards/shields/prisma_trackpad_xiao/Kconfig.defconfig
```kconfig
# SPDX-License-Identifier: MIT

if SHIELD_PRISMA_TRACKPAD_XIAO

config ZMK_KEYBOARD_NAME
    default "SD Trackpad"

endif
```

## zmk/boards/shields/prisma_trackpad_xiao/Kconfig.shield
```kconfig
# SPDX-License-Identifier: MIT

config SHIELD_PRISMA_TRACKPAD_XIAO
    def_bool $(shields_list_contains,prisma_trackpad_xiao)
```
